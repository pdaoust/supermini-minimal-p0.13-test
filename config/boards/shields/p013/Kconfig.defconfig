## config/boards/shields/p013/Kconfig.defconfig
```kconfig
# Copyright (c) 2020 The ZMK Contributors
# SPDX-License-Identifier: MIT

if SHIELD_P013

config ZMK_KEYBOARD_NAME
    default "P0.13"

endif
```

## config/boards/shields/p013/Kconfig.shield
```kconfig
# Copyright (c) 2020 The ZMK Contributors
# SPDX-License-Identifier: MIT

config SHIELD_P013
    def_bool $(shieldsv_list_contains,p013)
    select SPI
```
