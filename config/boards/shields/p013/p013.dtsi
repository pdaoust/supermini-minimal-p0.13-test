/*
 * Copyright (c) 2020 The ZMK Contributors
 *
 * SPDX-License-Identifier: MIT
 */

#include <dt-bindings/zmk/matrix_transform.h>

/ {
    chosen {
        zmk,kscan = &kscan0;
        zmk,matrix_transform = &default_transform;
    };

    default_transform: keymap_transform_0 {
        compatible = "zmk,matrix-transform";
        columns = <2>;
        rows = <2>;
        map = < RC(0,0) RC(0,1) RC(1,0) RC(1,1) >;
  };

    kscan0: kscan {
        compatible = "zmk,kscan-gpio-matrix";
        label = "KSCAN";

        diode-direction = "col2row";

        row-gpios
            = <&gpio0 13 (GPIO_ACTIVE_LOW | GPIO_PULL_UP)>
              <&gpio1 4  (GPIO_ACTIVE_LOW | GPIO_PULL_UP)>
            ;

        col-gpios
            = <&gpio0 14 (GPIO_ACTIVE_LOW | GPIO_PULL_UP)>
              <&gpio1 6  (GPIO_ACTIVE_LOW | GPIO_PULL_UP)>
            ;
    };
};
